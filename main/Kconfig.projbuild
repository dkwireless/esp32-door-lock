## main/Kconfig.projbuild
```kconfig
menu "Airbnk Gateway Configuration"

    config AIRBNK_LOCK_MAC
        string "Airbnk Lock MAC Address"
        default "E4:E1:12:C7:5C:52"
        help
            MAC address of the Airbnk smart lock to bridge.

    config AIRBNK_MQTT_BROKER_URI
        string "MQTT Broker URI"
        default "mqtt://192.168.6.11"
        help
            MQTT broker address, e.g. mqtt://192.168.6.11

    config AIRBNK_MQTT_USERNAME
        string "MQTT Username"
        default ""
        help
            MQTT username (leave empty if none).

    config AIRBNK_MQTT_PASSWORD
        string "MQTT Password"
        default ""
        help
            MQTT password (leave empty if none).

    config AIRBNK_MQTT_TOPIC_PREFIX
        string "MQTT Topic Prefix"
        default "tele/maindoor"
        help
            Prefix for MQTT topics: adv, command, command_result, LWT.

endmenu
```

## sdkconfig.defaults
```kconfig
# ESP32-C3 Airbnk BLE-to-MQTT Gateway defaults
#
# Build system
CONFIG_IDF_TARGET="esp32c3"
CONFIG_ESPTOOLPY_FLASHMODE_DIO=y
CONFIG_ESPTOOLPY_FLASHSIZE_4MB=y

# Partition table
CONFIG_PARTITION_TABLE_SINGLE_APP=y

# FreeRTOS
CONFIG_FREERTOS_HZ=1000
CONFIG_FREERTOS_UNICORE=n

# Main task stack (need more for WiFi + BLE + MQTT)
CONFIG_ESP_MAIN_TASK_STACK_SIZE=6144

# WiFi
CONFIG_ESP_WIFI_SSID=""
CONFIG_ESP_WIFI_PASSWORD=""
CONFIG_ESP_WIFI_STATIC_RX_BUFFER_NUM=10
CONFIG_ESP_WIFI_DYNAMIC_RX_BUFFER_NUM=32

# Bluetooth / NimBLE
CONFIG_BT_ENABLED=y
CONFIG_BT_BLE_ENABLED=y
CONFIG_BT_NIMBLE_ENABLED=y
CONFIG_BT_NIMBLE_MAX_CONNECTIONS=2
CONFIG_BT_NIMBLE_MAX_BONDS=0
CONFIG_BT_NIMBLE_MESH=n
CONFIG_BT_NIMBLE_CRYPTO_STACK_MBEDTLS=y
CONFIG_BTDM_CTRL_MODE_BLE_ONLY=y
CONFIG_BTDM_CTRL_BLE_MAX_CONN=2
CONFIG_BTDM_CTRL_BR_EDR_SCO_DATA_PATH_EFF=0
CONFIG_BTDM_CTRL_PCM_ROLE_EFF=0
CONFIG_BTDM_CTRL_PCM_POLAR_EFF=0
CONFIG_BTDM_CTRL_BLE_ADV_REPORT_FLOW_CTRL_SUPP=y
CONFIG_BTDM_CTRL_BLE_ADV_REPORT_FLOW_CTRL_NUM=100
CONFIG_BTDM_CTRL_BLE_ADV_REPORT_DISCARD_THRSHOLD=20
CONFIG_BTDM_CTRL_BLE_SCAN_DUPL=y

# MQTT
CONFIG_MQTT_PROTOCOL_311=y
CONFIG_MQTT_TRANSPORT_SSL=n
CONFIG_MQTT_TRANSPORT_WEBSOCKET=n
CONFIG_MQTT_TASK_CORE_SELECTION_ENABLED=n
CONFIG_MQTT_CUSTOM_OUTBOX=n

# cJSON
CONFIG_CJSON_ENABLED=y

# Logging
CONFIG_LOG_DEFAULT_LEVEL_INFO=y
CONFIG_LOG_MAXIMUM_LEVEL_DEBUG=y

# Airbnk Gateway
CONFIG_AIRBNK_LOCK_MAC="E4:E1:12:C7:5C:52"
CONFIG_AIRBNK_MQTT_BROKER_URI="mqtt://192.168.6.11"
CONFIG_AIRBNK_MQTT_USERNAME="mqttuser"
CONFIG_AIRBNK_MQTT_PASSWORD=""
CONFIG_AIRBNK_MQTT_TOPIC_PREFIX="tele/maindoor"
```
